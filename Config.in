## Config.in
```kconfig
#

mainmenu "Buildroot $BR2_VERSION Configuration"

config BR2_HAVE_DOT_CONFIG
	bool
	default y

config BR2_VERSION
	string
	option env="BR2_VERSION_FULL"

menu "What"

config BR2_GLOBAL_PATCH_DIR
	string "global patch directories"
    
endmenu
```
